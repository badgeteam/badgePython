## components/driver_display2pax/Kconfig
```kconfig
menu "Driver: framebuffer compatibility layer"
	config DRIVER_FRAMEBUFFER_COMPAT_ENABLE
		depends on DRIVER_PAX_ENABLE && !DRIVER_FRAMEBUFFER_ENABLE
		bool "Enable the PAX to legacy framebuffer API backwards-compatibility layer"
		default y
endmenu
```

## components/driver_display_depg0290b1/Kconfig
```kconfig
menu "Driver: DEPG0290B1 LCD display"
	config DRIVER_DEPG0290B1_ENABLE
		depends on BUS_VSPI_ENABLE
		bool "Enable the DEPG0290B1 display driver"
		default n
		
	config PIN_NUM_DEPG0290B1_RESET
		depends on DRIVER_DEPG0290B1_ENABLE
		int "GPIO pin used for RESET"
		default -1
	
	config PIN_NUM_DEPG0290B1_DCX
		depends on DRIVER_DEPG0290B1_ENABLE
		int "GPIO pin used for DC"
		default -1
		
	config PIN_NUM_DEPG0290B1_CS
		depends on DRIVER_DEPG0290B1_ENABLE
		int "GPIO pin used for CS"
		default -1
	
	config PIN_NUM_DEPG0290B1_BUSY
		depends on DRIVER_DEPG0290B1_ENABLE
		int "GPIO pin used for busy"
		default -1
endmenu
```

## components/driver_launcher/Kconfig
```kconfig
menu "Driver: Badge.team launcher"
	config DRIVER_BADGEAPI_ENABLE
		bool "Enable the Badge.team launcher driver"
		default n
endmenu
```

## components/driver_pax/Kconfig
```kconfig
menu "Driver: pax-graphics support"
	
	config DRIVER_PAX_ENABLE
		bool "Enable the pax-graphics driver"
		default n
	
	choice
		prompt "Framebuffer type"
		depends on DRIVER_PAX_ENABLE
		default DRIVER_PAX_BUF_16_565RGB
		help
			Framebuffer pixel format
		
		config DRIVER_PAX_BUF_1_PAL
			bool "1BPP palette"
		config DRIVER_PAX_BUF_2_PAL
			bool "2BPP palette"
		config DRIVER_PAX_BUF_4_PAL
			bool "4BPP palette"
		config DRIVER_PAX_BUF_8_PAL
			bool "8BPP palette"
		config DRIVER_PAX_BUF_16_PAL
			bool "16BPP palette"
		
		config DRIVER_PAX_BUF_1_GREY
			bool "1BPP black/white"
		config DRIVER_PAX_BUF_2_GREY
			bool "2BPP greyscale"
		config DRIVER_PAX_BUF_4_GREY
			bool "4BPP greyscale"
		config DRIVER_PAX_BUF_8_GREY
			bool "8BPP greyscale"
		
		config DRIVER_PAX_BUF_8_332RGB
			bool "8BPP 3,3,2-RGB"
		config DRIVER_PAX_BUF_16_565RGB
			bool "16BPP 5,6,5-RGB"
		
		config DRIVER_PAX_BUF_4_1111ARGB
			bool "4BPP 1-bit ARGB"
		config DRIVER_PAX_BUF_8_2222ARGB
			bool "8BPP 2-bit ARGB"
		config DRIVER_PAX_BUF_16_4444ARGB
			bool "16BPP 4-bit ARGB"
		config DRIVER_PAX_BUF_32_8888ARGB
			bool "32BPP 8-bit ARGB"
		
	endchoice
	
	config DRIVER_PAX_REVERSE_ENDIANNESS
		depends on DRIVER_PAX_ENABLE
		depends on DRIVER_PAX_BUF_16_PAL || DRIVER_PAX_BUF_16_565RGB || DRIVER_PAX_BUF_16_4444ARGB || DRIVER_PAX_BUF_32_8888ARGB
		bool "Reverse endianness"
		default y
	
	config DRIVER_PAX_FBWIDTH
		depends on DRIVER_PAX_ENABLE
		int "Framebuffer width"
		default 320
	config DRIVER_PAX_FBHEIGHT
		depends on DRIVER_PAX_ENABLE
		int "Framebuffer height"
		default 240
	
	config DRIVER_PAX_COMPAT
		depends on DRIVER_FRAMEBUFFER_ENABLE
		bool "Enable legacy framebuffer driver compatibility"
		default y
	
	choice
		prompt "Orientation"
		depends on DRIVER_PAX_ENABLE
		default DRIVER_PAX_ROT_0
		help
			Simulated screen orientation; PAX rotates draw calls to this orientation
		
		config DRIVER_PAX_ROT_0
			bool "Upright"
		config DRIVER_PAX_ROT_1
			bool "Rotated counter-clockwise"
		config DRIVER_PAX_ROT_2
			bool "Upside-down"
		config DRIVER_PAX_ROT_3
			bool "Rotated clockwise"
	endchoice
	
	config DRIVER_PAX_MCR
		depends on DRIVER_PAX_ENABLE
		bool "Compile multi-core rendering"
		default n
	config DRIVER_PAX_MCR_OPT
		depends on DRIVER_PAX_ENABLE
		depends on DRIVER_PAX_MCR
		bool "Enable multi-core rendering by default"
		default y
	
	config DRIVER_PAX_EXPERIMENTAL
		depends on DRIVER_PAX_ENABLE
		bool "Enable experimental features"
		default n
endmenu
```

## components/heapspace_tracker/Kconfig
```kconfig
menu "Driver: Heapspace tracker"
    config DRIVER_HEAPSPACE_ENABLE
            bool "Enable the heapspace tracker driver"
            default n
endmenu
```

## firmware/components/driver_display_sh1106/Kconfig
```kconfig
menu "Driver: SH1106 OLED display"
	config DRIVER_SH1106_ENABLE
		depends on DRIVER_I2C_ENABLE
		bool "Enable the SH1106 display driver"
		default n
	
	config I2C_ADDR_SH1106
		depends on DRIVER_SH1106_ENABLE
		int "SH1106 I2C address"
		default 60
	
	config PIN_NUM_SH1106_RESET
		depends on DRIVER_SH1106_ENABLE
		int "GPIO pin used for SH1106 reset"
endmenu
```
